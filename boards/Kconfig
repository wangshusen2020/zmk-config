## boards/shields/nordic_blinky/Kconfig.shield
```kconfig
# Nordic_Blinky Shield Kconfig

if SHIELD_NORDIC_BLINKY

config SHIELD_NAME
    default "nordic_blinky"

endif

config SHIELD_NORDIC_BLINKY
    bool "Nordic_Blinky LE Test Fixture"
    default y
```
